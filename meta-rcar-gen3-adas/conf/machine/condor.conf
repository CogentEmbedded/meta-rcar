## meta-rcar-gen3-adas/conf/machine/condor.conf
```bitbake
#@TYPE: Machine
#@NAME: Condor machine
#@DESCRIPTION: Machine configuration for running Condor

DEFAULTTUNE ?= "cortexa53"
require conf/machine/include/tune-cortexa53.inc
require conf/machine/include/${SOC_FAMILY}.inc

# 32BIT package install (default is disable)
# This variables can be used only in multilib.
USE_32BIT_PKGS ?= "0"
USE_32BIT_WAYLAND ?= "0"
USE_32BIT_MMP ?= "0"

MACHINE_FEATURES = ""

KERNEL_IMAGETYPE = "Image"
IMAGE_FSTYPES = "tar.bz2 ext4 cpio.gz"

SERIAL_CONSOLE = "115200 ttySC0"

# Configuration for kernel
PREFERRED_PROVIDER_virtual/kernel = "linux-renesas"
KERNEL_DEVICETREE = "renesas/r8a7798-condor.dtb"

# Configuration for CR7 Loader
EXTRA_IMAGEDEPENDS += " cr7-loader"

# Configuration for ARM Trusted Firmware
EXTRA_IMAGEDEPENDS += " arm-trusted-firmware"

# u-boot
PREFERRED_VERSION_u-boot = "v2015.04%"
EXTRA_IMAGEDEPENDS += " u-boot"
UBOOT_MACHINE = "r8a7798_condor_defconfig"

# libdrm
PREFERRED_VERSION_libdrm = "2.4.68"

# Add variable to Build Configuration in build log
BUILDCFG_VARS_append = " SOC_FAMILY"
```

## meta-rcar-gen3-adas/conf/machine/v3mzf.conf
```bitbake
#@TYPE: Machine
#@NAME: V3MZF machine
#@DESCRIPTION: Machine configuration for running V3MZF

DEFAULTTUNE ?= "cortexa53"
require conf/machine/include/tune-cortexa53.inc
require conf/machine/include/${SOC_FAMILY}.inc

# 32BIT package install (default is disable)
# This variables can be used only in multilib.
USE_32BIT_PKGS ?= "0"
USE_32BIT_WAYLAND ?= "0"
USE_32BIT_MMP ?= "0"

MACHINE_FEATURES = ""

KERNEL_IMAGETYPE = "Image"
IMAGE_FSTYPES = "tar.bz2 ext4 cpio.gz"

SERIAL_CONSOLE = "115200 ttySC0"

# Configuration for kernel
PREFERRED_PROVIDER_virtual/kernel = "linux-renesas"
KERNEL_DEVICETREE = "renesas/r8a7797-v3mzf.dtb"

# u-boot
PREFERRED_VERSION_u-boot = "v2015.04%"
EXTRA_IMAGEDEPENDS += " u-boot"
UBOOT_MACHINE = "v3mzf_defconfig"

# libdrm
PREFERRED_VERSION_libdrm = "2.4.68"

# Add variable to Build Configuration in build log
BUILDCFG_VARS_append = " SOC_FAMILY"
```
